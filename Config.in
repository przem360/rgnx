## Config.in
```kconfig
# Adding to "External options"
source "$BR2_EXTERNAL_RGNX_PATH/package/smsplus-gx/Config.in"
source "$BR2_EXTERNAL_RGNX_PATH/package/tenes/Config.in"
source "$BR2_EXTERNAL_RGNX_PATH/package/nofrendo/Config.in"
source "$BR2_EXTERNAL_RGNX_PATH/package/gnuboy/Config.in"
source "$BR2_EXTERNAL_RGNX_PATH/package/dgen/Config.in"
source "$BR2_EXTERNAL_RGNX_PATH/package/pocketsnes/Config.in"
source "$BR2_EXTERNAL_RGNX_PATH/package/tcc/Config.in"
```

## configs/rgnx_defconfig
```kconfig
BR2_x86_i486=y
BR2_TOOLCHAIN_EXTERNAL=y
BR2_TOOLCHAIN_EXTERNAL_DOWNLOAD=y
BR2_TOOLCHAIN_EXTERNAL_URL="https://musl.cc/i486-linux-musl-cross.tgz"
BR2_TOOLCHAIN_EXTERNAL_REL_BIN_PATH=""
BR2_TOOLCHAIN_EXTERNAL_CUSTOM_PREFIX="i486-linux-musl"
BR2_TOOLCHAIN_EXTERNAL_GCC_11=y
BR2_TOOLCHAIN_EXTERNAL_HEADERS_5_15=y
BR2_TOOLCHAIN_EXTERNAL_CUSTOM_MUSL=y
BR2_TOOLCHAIN_EXTERNAL_CXX=y
BR2_TOOLCHAIN_EXTERNAL_FORTRAN=y
BR2_TOOLCHAIN_EXTERNAL_OPENMP=y
BR2_SHARED_STATIC_LIBS=y
BR2_TARGET_GENERIC_HOSTNAME="rgnx"
BR2_TARGET_GENERIC_ISSUE="Welcome to RGNX"
BR2_TARGET_GENERIC_ROOT_PASSWD="rgnx"
BR2_TARGET_GENERIC_GETTY_PORT="tty1"
BR2_ROOTFS_OVERLAY="$(TOPDIR)/../board/rgnx/rootfs-overlay"
BR2_ROOTFS_POST_IMAGE_SCRIPT="$(TOPDIR)/../board/rgnx/post-image.sh"
BR2_LINUX_KERNEL=y
BR2_LINUX_KERNEL_CUSTOM_VERSION=y
BR2_LINUX_KERNEL_CUSTOM_VERSION_VALUE="6.14.11"
BR2_LINUX_KERNEL_USE_CUSTOM_CONFIG=y
BR2_LINUX_KERNEL_CUSTOM_CONFIG_FILE="$(TOPDIR)/../board/rgnx/linux.config"
BR2_LINUX_KERNEL_XZ=y
BR2_LINUX_KERNEL_INSTALL_TARGET=y
BR2_PACKAGE_BUSYBOX_CONFIG="$(TOPDIR)/../board/rgnx/busybox.config"
BR2_PACKAGE_ALSA_UTILS=y
BR2_PACKAGE_ALSA_UTILS_AMIXER=y
BR2_PACKAGE_ALSA_UTILS_SPEAKER_TEST=y
BR2_PACKAGE_MAKE=y
BR2_PACKAGE_ASCII_INVADERS=y
BR2_PACKAGE_SDL_GFX=y
BR2_PACKAGE_SDL_IMAGE=y
BR2_PACKAGE_SDL_MIXER=y
BR2_PACKAGE_SDL_MIXER_MIDI_TIMIDITY=y
BR2_PACKAGE_SDL_SOUND=y
BR2_PACKAGE_SDL_TTF=y
BR2_PACKAGE_ALSA_PLUGINS=y
BR2_PACKAGE_NANO=y
BR2_TARGET_ROOTFS_CPIO=y
BR2_TARGET_ROOTFS_CPIO_XZ=y
BR2_TARGET_ROOTFS_EXT2=y
BR2_TARGET_ROOTFS_EXT2_4=y
# BR2_TARGET_ROOTFS_TAR is not set
BR2_PACKAGE_SMSPLUS_GX=y
```

## package/dgen/Config.in
```kconfig
config BR2_PACKAGE_DGEN
	bool "dgen"
	depends on BR2_i386
	depends on BR2_INSTALL_LIBSTDCPP # rally?
	select BR2_PACKAGE_SDL
	select BR2_PACKAGE_ZLIB
	help
	  DGen/SDL to otwartoźródłowy emulator konsoli 
	  Sega Mega Drive / Genesis dla systemów Unix.

	  http://sourceforge.net/projects/dgen
```

## package/gnuboy/Config.in
```kconfig
config BR2_PACKAGE_GNUBOY
	bool "gnuboy"
	depends on BR2_PACKAGE_SDL
	help
	  Gnuboy is a classic, ultra-fast Game Boy and Game Boy Color 
	  emulator revived for modern compilers.
```

## package/nofrendo/Config.in
```kconfig
config BR2_PACKAGE_NOFRENDO
	bool "nofrendo"
	depends on BR2_i386 # Pilnujemy, aby pakiet był widoczny tylko dla platformy x86 32-bit
	select BR2_PACKAGE_SDL
	select BR2_PACKAGE_ZLIB
	help
	  Nofrendo jest lekkim, klasycznym emulatorem NES,
	  idealnym dla procesorów klasy i386 / i486.

	  http://www.conte.com/nofrendo/
```

## package/picodrive/Config.in
```kconfig
config BR2_PACKAGE_PICODRIVE
    bool "picodrive"
    depends on BR2_PACKAGE_SDL
    select BR2_PACKAGE_ZLIB
    help
      PicoDrive is a high-performance Sega Genesis/Mega Drive, 
      Sega CD/Mega CD and Master System emulator.
```

## package/pocketsnes/Config.in
```kconfig
config BR2_PACKAGE_POCKETSNES
	bool "pocketsnes"
	select BR2_PACKAGE_SDL
	select BR2_PACKAGE_SDL_IMAGE
	select BR2_PACKAGE_ZLIB
	select BR2_PACKAGE_LIBPNG
	help
	  PocketSNES is an emulator of Super Nintendo (SNES) based on
	  snes9x 1.43, works with SDL 1.2

	  https://github.com/przem360/rgnx_pocketsnes
```

## package/smsplus-gx/Config.in
```kconfig
config BR2_PACKAGE_SMSPLUS_GX
    bool "smsplus-gx"
    select BR2_PACKAGE_SDL
    help
      SMS Plus SDL is a portable Sega Master System and 
      Game Gear emulator. Perfect for Pentium II.

      https://github.com/przem360/sms_sdl
```

## package/tcc/Config.in
```kconfig
config BR2_PACKAGE_TCC
	bool "tcc"
	help
	  Tiny C Compiler - to mniejszy, niezwykle szybki kompilator C,
	  który potrafi uruchamiać pliki źródłowe C bezpośrednio jako
	  skrypty za pomocą flagi -run. Idealny dla systemów wbudowanych.

	  http://bellard.org/tcc/
```

## package/tenes/Config.in
```kconfig
config BR2_PACKAGE_TENES
	bool "tenes"
	depends on BR2_PACKAGE_SDL
	select BR2_PACKAGE_FREETYPE
	select BR2_PACKAGE_SDL_IMAGE
	help
	  Tenes is a lightweight NES (Nintendo Entertainment System) 
	  emulator based on SDL 1.2 and FreeType2.
```
